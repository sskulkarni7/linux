## arch/arm64/Kconfig.debug
```kconfig
# SPDX-License-Identifier: GPL-2.0-only

config PID_IN_CONTEXTIDR
	bool "Write the current PID to the CONTEXTIDR register"
	help
	  Enabling this option causes the kernel to write the current PID to
	  the CONTEXTIDR register, at the expense of some additional
	  instructions during context switch. Say Y here only if you are
	  planning to use hardware trace tools with this kernel.

config DEBUG_EFI
	depends on EFI && DEBUG_INFO
	bool "UEFI debugging"
	help
	  Enable this option to include EFI specific debugging features into
	  the kernel that are only useful when using a debug build of the
	  UEFI firmware

config ARM64_RELOC_TEST
	depends on m
	tristate "Relocation testing module"

config DEBUG_TLBFLUSH
	bool "Add vmstat counters to analyze TLB handling"
	depends on DEBUG_KERNEL
	help
	 This option adds vmstat counters that track how arm64 TLB invalidations
	 are handled, specifically how many take the local fast path versus a
	 broadcast. The counts are exposed in /proc/vmstat and are useful for
	 analyzing the active_cpu optimization. If unsure, say N.

source "drivers/hwtracing/coresight/Kconfig"
```

## tests/Kconfig
```kconfig
menuconfig BENCHMARKS
	bool "In kernel benchmarks"
	def_bool n
	help
	  Includes in kernel benchmark modules in the build. These modules can
	  be loaded later to trigger benchmarking kernel subsystems.
	  Output will be generated in the system log.

if BENCHMARKS

config BENCHMARK_TLBFLUSH
	tristate "TLB flush local vs broadcast benchmark"
	depends on m && ARM64 && PERF_EVENTS
	default m
	help
	  Measures the cycle cost of flush_tlb_mm()/flush_tlb_page() when
	  the active_cpu optimization takes the local-only fast path versus
	  when it must broadcast to all CPUs.

config BENCHMARK_TLBFLUSH_WARM
	tristate "TLB flush broadcast benchmark with warmed remote TLBs"
	depends on m && ARM64 && PERF_EVENTS
	default m
	help
	  Like BENCHMARK_TLBFLUSH, but keeps every remote CPU's TLB warm
	  during the broadcast phase (one kthread per remote CPU) to test
	  whether remote entry presence affects broadcast latency.

endif # BENCHMARKS
```
